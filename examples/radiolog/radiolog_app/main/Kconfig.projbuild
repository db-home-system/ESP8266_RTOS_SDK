## examples/radiolog/radiolog_app/main/Kconfig.projbuild
```kconfig
menu "Radiolog Configuration"
    config BROKER_URL
        string "Broker URL"
        default "mqtt://mqtt.eclipse.org"
        help
            URL of the broker to connect to

    config FIRMWARE_UPGRADE_URL
        string "firmware upgrade url endpoint"
        default "https://192.168.0.3:8070/hello-world.bin"
        help
            URL of server which hosts the firmware
            image.

    config RADIOLOG_WIFI_SSID
        string "WiFi SSID"
        default "myssid"
        help
            SSID (network name) for the example to connect to.

    config RADIOLOG_WIFI_PASSWORD
        string "WiFi Password"
        default "mypassword"
        help
            WiFi password (WPA or WPA2) for the example to use.
            Can be left blank if the network has no security set.

    config RADIOLOG_CONNECT_IPV6
        bool "Obtain IPv6 address"
        default n
        select LWIP_IPV6
        help
            By default, examples will wait until IPv4 and IPv6 local link addresses are obtained.
            Disable this option if the network does not support IPv6.
            Choose the preferred IPv6 address type if the connection code should wait until other than
            the local link address gets assigned.

    if RADIOLOG_CONNECT_IPV6
        choice RADIOLOG_CONNECT_PREFERRED_IPV6
            prompt "Preferred IPv6 Type"
            default RADIOLOG_CONNECT_IPV6_PREF_LOCAL_LINK
            help
                Select which kind of IPv6 address the connect logic waits for.

            config RADIOLOG_CONNECT_IPV6_PREF_LOCAL_LINK
                bool "Local Link Address"
                help
                    Blocks until Local link address assigned.

            config RADIOLOG_CONNECT_IPV6_PREF_GLOBAL
                bool "Global Address"
                select LWIP_IPV6_AUTOCONFIG
                help
                    Blocks until Global address assigned.
        endchoice
    endif
endmenu
```
